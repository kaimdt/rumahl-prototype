## iora-os/configs/iora_defconfig
```kconfig
# Buildroot Configuration for IORA OS
# Custom Linux OS for IORA Smart Home System

# Target Architecture
BR2_x86_64=y
BR2_X86_64_CORE2=y

# Toolchain
BR2_TOOLCHAIN_BUILDROOT_GLIBC=y
BR2_TOOLCHAIN_BUILDROOT_CXX=y

# Kernel
BR2_LINUX_KERNEL=y
BR2_LINUX_KERNEL_CUSTOM_VERSION=y
BR2_LINUX_KERNEL_CUSTOM_VERSION_VALUE="6.6.15"
BR2_LINUX_KERNEL_USE_CUSTOM_CONFIG=y
BR2_LINUX_KERNEL_CUSTOM_CONFIG_FILE="$(BR2_EXTERNAL_IORA_PATH)/board/iora/linux.config"
BR2_LINUX_KERNEL_NEEDS_HOST_OPENSSL=y

# Compression
BR2_LINUX_KERNEL_LZ4=y

# Bootloader
BR2_TARGET_GRUB2=y
BR2_TARGET_GRUB2_X86_64_EFI=y

# System
BR2_TARGET_GENERIC_HOSTNAME="iora"
BR2_TARGET_GENERIC_ISSUE="Welcome to IORA OS"
BR2_ROOTFS_DEVICE_CREATION_DYNAMIC_EUDEV=y
BR2_TARGET_GENERIC_ROOT_PASSWD="iora"
BR2_SYSTEM_DHCP="eth0"

# Init system
BR2_INIT_SYSTEMD=y
BR2_ROOTFS_DEVICE_CREATION_DYNAMIC_EUDEV=y

# Filesystem
BR2_TARGET_ROOTFS_SQUASHFS=y
BR2_TARGET_ROOTFS_SQUASHFS4_LZ4=y

# Required packages
BR2_PACKAGE_BUSYBOX=y
BR2_PACKAGE_BASH=y
BR2_PACKAGE_BASH_COMPLETION=y

# Docker support
BR2_PACKAGE_DOCKER_ENGINE=y
BR2_PACKAGE_DOCKER_CLI=y
BR2_PACKAGE_DOCKER_COMPOSE=y
BR2_PACKAGE_CONTAINERD=y

# Network tools
BR2_PACKAGE_IPROUTE2=y
BR2_PACKAGE_IPUTILS=y
BR2_PACKAGE_ETHTOOL=y
BR2_PACKAGE_IPTABLES=y
BR2_PACKAGE_OPENSSH=y
BR2_PACKAGE_OPENSSL=y
BR2_PACKAGE_CA_CERTIFICATES=y
BR2_PACKAGE_CURL=y
BR2_PACKAGE_WGET=y

# Compression utilities
BR2_PACKAGE_ZLIB=y
BR2_PACKAGE_LZ4=y
BR2_PACKAGE_XZ=y

# File systems
BR2_PACKAGE_E2FSPROGS=y
BR2_PACKAGE_SQUASHFS=y
BR2_PACKAGE_ZRAM_TOOLS=y

# System utilities
BR2_PACKAGE_HTOP=y
BR2_PACKAGE_NANO=y
BR2_PACKAGE_VIM=y
BR2_PACKAGE_LESS=y
BR2_PACKAGE_TMUX=y
BR2_PACKAGE_SCREEN=y

# Hardware support
BR2_PACKAGE_PCI_UTILS=y
BR2_PACKAGE_USB_UTILS=y

# Python (for utilities)
BR2_PACKAGE_PYTHON3=y
BR2_PACKAGE_PYTHON_PIP=y

# RAUC update system
BR2_PACKAGE_RAUC=y
BR2_PACKAGE_RAUC_SERVICE=y
BR2_PACKAGE_RAUC_NETWORK=y

# AppArmor security
BR2_PACKAGE_APPARMOR=y
BR2_PACKAGE_APPARMOR_UTILS=y

# PostgreSQL client libraries
BR2_PACKAGE_POSTGRESQL=y

# Time synchronization
BR2_PACKAGE_CHRONY=y

# Disk image
BR2_TARGET_ROOTFS_EXT2=y
BR2_TARGET_ROOTFS_EXT2_4=y
BR2_TARGET_ROOTFS_EXT2_SIZE="8G"

# Post-build scripts
BR2_ROOTFS_POST_BUILD_SCRIPT="$(BR2_EXTERNAL_IORA_PATH)/board/iora/post-build.sh"
BR2_ROOTFS_POST_IMAGE_SCRIPT="$(BR2_EXTERNAL_IORA_PATH)/board/iora/post-image.sh"
BR2_ROOTFS_OVERLAY="$(BR2_EXTERNAL_IORA_PATH)/board/iora/rootfs-overlay"

# External tree
BR2_EXTERNAL_IORA_PATH="$(BR2_EXTERNAL)/iora"
```

## rumahl-os/configs/rumahl_rpi_defconfig
```kconfig
# Buildroot Configuration for rumahl OS - Raspberry Pi ARM64
# Custom Linux OS for rumahl Smart Home System on Raspberry Pi

# Target Architecture
BR2_aarch64=y
BR2_cortex_a72=y

# Toolchain
BR2_TOOLCHAIN_BUILDROOT_GLIBC=y
BR2_TOOLCHAIN_BUILDROOT_CXX=y

# Kernel
BR2_LINUX_KERNEL=y
BR2_LINUX_KERNEL_CUSTOM_VERSION=y
BR2_LINUX_KERNEL_CUSTOM_VERSION_VALUE="6.6.15"
BR2_LINUX_KERNEL_USE_CUSTOM_CONFIG=y
BR2_LINUX_KERNEL_CUSTOM_CONFIG_FILE="$(BR2_EXTERNAL_RUMAHL_PATH)/board/rumahl/linux.config"
BR2_LINUX_KERNEL_NEEDS_HOST_OPENSSL=y
BR2_LINUX_KERNEL_DTS_SUPPORT=y
BR2_LINUX_KERNEL_INTREE_DTS_NAME="broadcom/bcm2711-rpi-4-b"

# Compression
BR2_LINUX_KERNEL_LZ4=y

# Bootloader - U-Boot for Raspberry Pi
BR2_TARGET_UBOOT=y
BR2_TARGET_UBOOT_BUILD_SYSTEM_KCONFIG=y
BR2_TARGET_UBOOT_CUSTOM_VERSION=y
BR2_TARGET_UBOOT_CUSTOM_VERSION_VALUE="2024.01"
BR2_TARGET_UBOOT_BOARD_DEFCONFIG="rpi_4"
BR2_TARGET_UBOOT_NEEDS_DTC=y

# Raspberry Pi firmware and boot files
BR2_PACKAGE_RPI_FIRMWARE=y
BR2_PACKAGE_RPI_FIRMWARE_BOOTCODE_BIN=y
BR2_PACKAGE_RPI_FIRMWARE_VARIANT_PI4=y
BR2_PACKAGE_RPI_FIRMWARE_CONFIG_FILE="$(BR2_EXTERNAL_RUMAHL_PATH)/board/rumahl-rpi/config.txt"

# System
BR2_TARGET_GENERIC_HOSTNAME="ora"
BR2_TARGET_GENERIC_ISSUE="Welcome to rumahl OS"
BR2_TARGET_GENERIC_ROOT_PASSWD="ora"
BR2_SYSTEM_DHCP="eth0"

# Init system
BR2_INIT_SYSTEMD=y
BR2_ROOTFS_DEVICE_CREATION_DYNAMIC_EUDEV=y

# Filesystem
BR2_TARGET_ROOTFS_SQUASHFS=y
BR2_TARGET_ROOTFS_SQUASHFS4_LZ4=y
BR2_TARGET_ROOTFS_CPIO=y
BR2_TARGET_ROOTFS_CPIO_GZIP=y

# Required packages
BR2_PACKAGE_BUSYBOX=y
BR2_PACKAGE_BASH=y
BR2_PACKAGE_BASH_COMPLETION=y

# Docker support
BR2_PACKAGE_DOCKER_ENGINE=y
BR2_PACKAGE_DOCKER_CLI=y
BR2_PACKAGE_DOCKER_COMPOSE=y
BR2_PACKAGE_CONTAINERD=y

# Network tools
BR2_PACKAGE_IPROUTE2=y
BR2_PACKAGE_IPUTILS=y
BR2_PACKAGE_ETHTOOL=y
BR2_PACKAGE_IPTABLES=y
BR2_PACKAGE_OPENSSH=y
BR2_PACKAGE_OPENSSL=y
BR2_PACKAGE_CA_CERTIFICATES=y
BR2_PACKAGE_LIBCURL_CURL=y
BR2_PACKAGE_WGET=y
BR2_PACKAGE_WIRELESS_TOOLS=y
BR2_PACKAGE_WPA_SUPPLICANT=y

# Compression utilities
BR2_PACKAGE_ZLIB=y
BR2_PACKAGE_LZ4=y
BR2_PACKAGE_XZ=y

# File systems
BR2_PACKAGE_E2FSPROGS=y
BR2_PACKAGE_SQUASHFS=y
BR2_PACKAGE_ZRAM_TOOLS=y
BR2_PACKAGE_DOSFSTOOLS=y
BR2_PACKAGE_F2FS_TOOLS=y

# System utilities
BR2_PACKAGE_HTOP=y
BR2_PACKAGE_NANO=y
BR2_PACKAGE_VIM=y
BR2_PACKAGE_LESS=y
BR2_PACKAGE_TMUX=y
BR2_PACKAGE_SCREEN=y
BR2_PACKAGE_DIALOG=y

# Boot splash screen
BR2_PACKAGE_PLYMOUTH=y
BR2_PACKAGE_PLYMOUTH_THEMES=y
BR2_PACKAGE_FBV=y
BR2_PACKAGE_FBSET=y

# Hardware support - Raspberry Pi specific
BR2_PACKAGE_RPI_USERLAND=y
BR2_PACKAGE_RPI_BT_FIRMWARE=y
BR2_PACKAGE_RPI_WIFI_FIRMWARE=y
BR2_PACKAGE_USB_UTILS=y
BR2_PACKAGE_PARTED=y
BR2_PACKAGE_GPTFDISK=y
BR2_PACKAGE_SMARTMONTOOLS=y
BR2_PACKAGE_UTIL_LINUX_CFDISK=y
BR2_PACKAGE_UTIL_LINUX_FDISK=y

# Python (for utilities)
BR2_PACKAGE_PYTHON3=y
BR2_PACKAGE_PYTHON_PIP=y

# RAUC update system
BR2_PACKAGE_RAUC=y
BR2_PACKAGE_RAUC_SERVICE=y
BR2_PACKAGE_RAUC_NETWORK=y

# AppArmor security
BR2_PACKAGE_APPARMOR=y
BR2_PACKAGE_APPARMOR_UTILS=y

# Hardware security (limited on Raspberry Pi - no TPM by default)
BR2_PACKAGE_RNG_TOOLS=y
BR2_PACKAGE_HAVEGED=y

# PostgreSQL client libraries
BR2_PACKAGE_POSTGRESQL=y

# Time synchronization
BR2_PACKAGE_CHRONY=y

# Disk image
BR2_TARGET_ROOTFS_EXT2=y
BR2_TARGET_ROOTFS_EXT2_4=y
BR2_TARGET_ROOTFS_EXT2_SIZE="8G"

# Post-build scripts
BR2_ROOTFS_POST_BUILD_SCRIPT="$(BR2_EXTERNAL_RUMAHL_PATH)/board/rumahl-rpi/post-build.sh"
BR2_ROOTFS_POST_IMAGE_SCRIPT="$(BR2_EXTERNAL_RUMAHL_PATH)/board/rumahl-rpi/post-image.sh"
BR2_ROOTFS_OVERLAY="$(BR2_EXTERNAL_RUMAHL_PATH)/board/rumahl-rpi/rootfs-overlay"

# External tree
BR2_EXTERNAL_RUMAHL_PATH="$(BR2_EXTERNAL)"

# rumahl Security Center providers
BR2_PACKAGE_NFTABLES=y
BR2_PACKAGE_CLAMAV=y
BR2_PACKAGE_YARA=y

# rumahl runtime sensor eBPF pipeline
BR2_PACKAGE_LIBBPF=y
BR2_PACKAGE_HOST_CLANG=y
BR2_PACKAGE_HOST_BPFTOOL=y
BR2_PACKAGE_RUMAHL_RUNTIME_SENSOR_EBPF_LOADER=y
```

## rumahl-os/package/rumahl-dev-toolchain/Config.in
```kconfig
config BR2_PACKAGE_RUMAHL_DEV_TOOLCHAIN
	bool "ora dev native build toolchain"
	depends on BR2_aarch64 || BR2_x86_64
	depends on BR2_TOOLCHAIN_GLIBC
	depends on BR2_USE_MMU
	depends on BR2_INSTALL_LIBSTDCPP
	depends on !BR2_STATIC_LIBS
	select BR2_PACKAGE_BINUTILS
	select BR2_PACKAGE_BINUTILS_TARGET
	select BR2_PACKAGE_CA_CERTIFICATES
	select BR2_PACKAGE_CLANG
	select BR2_PACKAGE_CMAKE
	select BR2_PACKAGE_GIT
	select BR2_PACKAGE_LIBCURL_CURL
	select BR2_PACKAGE_MAKE
	select BR2_PACKAGE_NODEJS
	select BR2_PACKAGE_NODEJS_NPM
	select BR2_PACKAGE_OPENSSL
	select BR2_PACKAGE_PERL
	select BR2_PACKAGE_PKGCONF
	select BR2_PACKAGE_POSTGRESQL
	select BR2_PACKAGE_PYTHON3
	select BR2_PACKAGE_PYTHON_PIP
	help
	  Install native build tooling into rumahl OS Dev images so the
	  developer bridge can build Rust/Node/Python based services on
	  the device without pulling large Docker builder images.

	  This intentionally makes DEV images larger. Do not enable this
	  package for production images.
```

## rumahl-os/package/rumahl-runtime-sensor-ebpf-loader/Config.in
```kconfig
config BR2_PACKAGE_RUMAHL_RUNTIME_SENSOR_EBPF_LOADER
	bool "rumahl-runtime-sensor-ebpf-loader"
	depends on BR2_LINUX_KERNEL
	depends on BR2_PACKAGE_LIBBPF
	depends on BR2_PACKAGE_HOST_CLANG
	depends on BR2_PACKAGE_HOST_BPFTOOL
	help
	  Observation-only CO-RE eBPF loader and ring-buffer consumer for
	  the rumahl runtime sensor. Loads runtime.bpf.o, enriches connect
	  events and forwards every event as a JSON line to
	  rumahl-runtime-sensor over its Unix socket.

	  This is the single component permitted to hold CAP_BPF and
	  CAP_PERFMON (Security Foundation baseline runtime sensor
	  privileged exception). It performs no host mutations.

	  https://github.com/rumahl/ora
```
